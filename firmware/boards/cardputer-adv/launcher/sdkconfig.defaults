## firmware/boards/cardputer-adv/launcher/sdkconfig.defaults
```kconfig
CONFIG_OKOU_BOARD_PROFILE="cardputer-adv"
CONFIG_ESPTOOLPY_FLASHSIZE_8MB=y
CONFIG_PARTITION_TABLE_CUSTOM_FILENAME="../boards/cardputer-adv/launcher/partitions.csv"
```

## firmware/boards/paper-color/launcher/sdkconfig.defaults
```kconfig
CONFIG_OKOU_BOARD_PROFILE="paper-color"
CONFIG_PARTITION_TABLE_CUSTOM_FILENAME="partitions/16mb.csv"
```

## firmware/boards/paper-diy/launcher/sdkconfig.defaults
```kconfig
CONFIG_OKOU_BOARD_PROFILE="paper-diy"
CONFIG_PARTITION_TABLE_CUSTOM_FILENAME="partitions/16mb.csv"
```

## firmware/boards/stackchan/launcher/sdkconfig.defaults
```kconfig
CONFIG_OKOU_BOARD_PROFILE="stackchan"
CONFIG_PARTITION_TABLE_CUSTOM_FILENAME="partitions/16mb.csv"
```

## firmware/boards/stopwatch/launcher/sdkconfig.defaults
```kconfig
CONFIG_OKOU_BOARD_PROFILE="stopwatch"
CONFIG_PARTITION_TABLE_CUSTOM_FILENAME="../boards/stopwatch/launcher/partitions.csv"
```

## firmware/bootloader/common/main/Kconfig.projbuild
```kconfig
menu "esp-bootloader"

    config OKL_USB_CDC
        bool "USB OTG CDC provisioning console"
        depends on IDF_TARGET_ESP32S31 && TINYUSB_CDC_ENABLED

    config OKL_URL_OTA
        bool
        default y

    config OKL_AUTOSTART_MS
        int "Auto-start the app this long after boot (ms)"
        default 3000

    config OKL_FAILSAFE_WAIT_S
        int "Auto-start delay after an app rollback (s)"
        default 30
        help
            After an app rollback, the bootloader waits longer before starting the app
            again so an operator can intervene. Any hub request cancels auto-start.

endmenu
```

## firmware/bootloader/esp32s31-16mb/sdkconfig.defaults
```kconfig
CONFIG_ESPTOOLPY_FLASHSIZE_16MB=y
CONFIG_OKOU_BL_PROFILE="esp32s31-16mb"
CONFIG_ESP_CONSOLE_UART_DEFAULT=y
```

## firmware/bootloader/main/Kconfig.projbuild
```kconfig
menu "esp-bootloader"

    config OKL_URL_OTA
        bool
        default y

    config OKL_AUTOSTART_MS
        int "Auto-start the app this long after boot (ms)"
        default 3000

    config OKL_FAILSAFE_WAIT_S
        int "Auto-start delay after an app rollback / fail_boots trip (s)"
        default 30
        help
            Extension to docs/protocol.md: after the app failed (bootloader rollback or
            okl/fail_boots >= 3) the bootloader waits longer before starting it again so an
            operator can catch it; any hub request cancels auto-start.

endmenu
```

## firmware/components/okou_agent/Kconfig
```kconfig
menu "okou agent (esp-launcher SDK)"

    config OKOU_BOARD_PROFILE
        string "Board profile reported by a board-specific application"
        default ""

    config OKOU_NET_OPENETH
        bool "Use OpenCores Ethernet (QEMU) instead of Wi-Fi"
        depends on ETH_USE_OPENETH
        default n
        help
            For Espressif QEMU builds (-nic user,model=open_eth). Wi-Fi is not initialised.

    config OKOU_QEMU_SYSTEM_RESET
        bool "QEMU workaround: make esp_restart() a full system reset"
        depends on OKOU_NET_OPENETH
        default y
        help
            Espressif QEMU does not reset peripherals on SW_CPU_RESET; the next boot then
            crashes in esp_timer_init. Only for QEMU builds.

    config OKOU_LOG_BUF_SIZE
        int "Log retain ring buffer size (bytes, rounded down to a power of two)"
        range 2048 131072
        default 16384

    config OKOU_LOG_LINE_MAX
        int "Max captured log line length (bytes; longer lines are truncated)"
        range 64 480
        default 192
        help
            The formatting buffer lives on the logging task's stack.

    config OKOU_TX_FRAME_MAX
        int "Max outgoing frame size (bytes, protocol limit 16384)"
        range 2048 16384
        default 6144

    config OKOU_MAX_CMDS
        int "Max registered commands"
        default 24

    config OKOU_MAX_PARAMS
        int "Max registered params"
        default 24

    config OKOU_CMD_OUT_MAX
        int "Max command output (bytes)"
        range 256 12288
        default 4096

    config OKOU_TASK_STACK
        int "Agent task stack size"
        default 6144

    config OKOU_TASK_PRIO
        int "Agent task priority (keep low)"
        default 2

    config OKOU_MAX_FAIL_BOOTS
        int "Boots without a hub ack before the SDK boots the launcher (0 = never)"
        range 0 20
        default 3

    config OKOU_MICROPYTHON_RUNTIME
        bool "ESP Hub MicroPython runtime"
        default n

    config OKOU_BLE_WIFI
        bool
        default y if BT_NIMBLE_ENABLED && !OKOU_NET_OPENETH

endmenu
```

## firmware/launcher/main/Kconfig.projbuild
```kconfig
menu "esp-launcher"

    config OKL_URL_OTA
        bool
        default y

    config OKL_AUTOSTART_MS
        int "Auto-start the app this long after boot (ms)"
        default 3000

    config OKL_FAILSAFE_WAIT_S
        int "Auto-start delay after an app rollback / fail_boots trip (s)"
        default 30
        help
            Extension to docs/protocol.md: after the app failed (bootloader rollback or
            okl/fail_boots >= 3) the launcher waits longer before starting it again so an
            operator can catch it; any hub request cancels auto-start.

    config OKL_VALIDATE_TIMEOUT_S
        int "New launcher: roll back if the hub has not acked hello within (s)"
        default 300

    choice OKL_BOARD
        prompt "Board"
        default OKL_BOARD_GENERIC
        config OKL_BOARD_GENERIC
            bool "Generic (no board bring-up)"
        config OKL_BOARD_M5_STOPWATCH
            bool "M5Stack StopWatch (M5PM1 power hold, watchdog off)"
            depends on IDF_TARGET_ESP32S3
    endchoice

    config OKL_PROV_BUTTON_GPIO
        int "BOOT button GPIO (hold 3 s: stay in launcher for USB setup); -1 = none"
        range -1 48
        default 0

endmenu
```
